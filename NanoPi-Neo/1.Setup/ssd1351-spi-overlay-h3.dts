/*
 * Device Tree overlay for SSD1351 based SPI OLED display
 *
 */

/dts-v1/;
/plugin/;

&pio {
    ssd1351_pins: ssd1351_pins {
        pins = "PA6", "PG9";
        function = "gpio_out";
    };
};

&spi0 {
    ssd1351: ssd1351@0{
        compatible = "solomon,ssd1351";
        reg = <0>;
        pinctrl-names = "default";
        pinctrl-0 = <&ssd1351_pins>;
    
        spi-max-frequency = <4500000>;
        bgr = <0>;
        bpp = <16>;
        rotate = <0>;
        fps = <25>;
        buswidth = <8>;
        reset-gpios = <&pio 0 6 1>; // PA6
        dc-gpios = <&pio 6 9 0>;    // PG9
        debug = <0>;
    
        solomon,height = <128>;
        solomon,width = <128>;
        solomon,page-offset = <0>;
    };
};